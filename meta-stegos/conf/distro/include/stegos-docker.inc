## meta-stegos/conf/distro/include/stegos-harden.inc
```bitbake
EXTRA_IMAGE_FEATURES:remove = "debug-tweaks"

IMAGE_FEATURES:remove = "package-management"

DISTRO_FEATURES:append = " acl xattr pam selinux"

PREFERRED_PROVIDER_virtual/refpolicy = "refpolicy-targeted"
```

## meta-stegos/conf/distro/stegos.conf
```bitbake
# Initialization Manager
INIT_MANAGER = "sysvinit"

# Removed Distro Features
DISTRO_FEATURES:remove = " systemd x11 wayland vulkan alsa pulseaudio"

# Added Distro Features
DISTRO_FEATURES:append = " virtualization seccomp"

require conf/distro/include/stegos-harden.inc

DISTRO = "stegos"
DISTRO_NAME = "stegOS"
DISTRO_VERSION = "0.1"

hostname:pn-base-files = "stegos"
```

## meta-stegos/conf/layer.conf
```bitbake
BBPATH .= ":${LAYERDIR}"

BBFILES += "${LAYERDIR}/recipes-*/*/*.bb \
            ${LAYERDIR}/recipes-*/*/*.bbappend"

BBFILE_COLLECTIONS += "stegos"
BBFILE_PATTERN_stegos = "^${LAYERDIR}/"
BBFILE_PRIORITY_stegos = "6"

LAYERSERIES_COMPAT_stegos = "wrynose"
```

## meta-stegos/conf/machine/stegos-qemu.conf
```bitbake
require conf/machine/qemux86-64.conf

MACHINEOVERRIDES =. "qemux86-64:"
KMACHINE = "qemux86-64"

MACHINE_FEATURES:remove = "alsa bluetooth touchscreen"

KERNEL_FEATURES += "features/security/security.scc"

IMAGE_FSTYPES += "iso"
```
